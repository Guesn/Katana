#include <SPI.h>
#include <Wire.h>
#include <Adafruit_GFX.h>
#include <Adafruit_SSD1306.h>

// 'Splash', 128x32px
const unsigned char Splash[] PROGMEM = {
  0xff, 0x3f, 0x80, 0x00, 0x00, 0x00, 0x00, 0x00, 0x00, 0x00, 0x00, 0x00, 0x00, 0x00, 0x00, 0x00, 
  0x3e, 0x1e, 0x00, 0x00, 0x00, 0x00, 0x00, 0x00, 0x00, 0x00, 0x00, 0x00, 0x00, 0x00, 0x00, 0x00, 
  0x3c, 0x18, 0x00, 0x00, 0x00, 0x00, 0x00, 0x00, 0x00, 0x00, 0x00, 0x00, 0x00, 0x00, 0x00, 0x00, 
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  0x00, 0x00, 0x00, 0x00, 0x00, 0x00, 0x00, 0x00, 0x00, 0x00, 0x00, 0x00, 0x00, 0x00, 0x00, 0x00
};

// Tableau des fonctions
int maxi = 5;
int minus;
int maximus;
char *fonctions[]={"Testeur 48V", "Generateur 1KHz", "Testeur de cables", "Entree DMX", "Sortie DMX", "Infos"};

//Déclaration des pinout
int Btnup = 2;
int Btndown = 3;
int Btnvalid = 13;

int InLed = LED_BUILTIN;

// Fiche XLR Mâle
int M1 = 4;
int M2 = 5;
int M3 = 6;

// Fiche XLR Femelle
int F1 = 7;
int F2 = 8;
int F3 = 9;

// Routage XLR
int malein = 10;
int femelleout = 11;
int maleanalo = 12;

// Liaisons
char transfert[] = {'-','-','-',0};
char L1[] = {'-','-','-',0};
char L2[] = {'-','-','-',0};
char L3[] = {'-','-','-',0};

// Écran
Adafruit_SSD1306 display = Adafruit_SSD1306(128, 32, &Wire);

// Déclaration des variables
int menu = 0;
int Oldmenu = 9;
int Etatup = 0;
int Oldup = 0;
int Etatdown = 0;
int Olddown = 0;
int Etatvalid = 0;
int Oldvalid = 0;
bool action = false;
int send = 0;


void setup() {

  // init com série
  Serial.begin(115200);
  
  // init écran
  display.begin(SSD1306_SWITCHCAPVCC, 0x3C);
  
  // init boutons
  pinMode(InLed, OUTPUT);
  pinMode(Btnup, INPUT);
  pinMode(Btndown, INPUT);
  
  // init XLR
  pinMode(M1, INPUT);
  pinMode(M2, INPUT);
  pinMode(M3, INPUT);
  pinMode(F1, OUTPUT);
  pinMode(F2, OUTPUT);
  pinMode(F3, OUTPUT);
  
  // init Routage
  pinMode(malein, OUTPUT);
  pinMode(femelleout, OUTPUT);
  pinMode(maleanalo, OUTPUT);

  // Affichage du Splash screen
  display.display();
  display.clearDisplay();
  display.drawBitmap(0, 0, Splash, 128, 32, WHITE);
  display.display();
  delay(2000);
  display.clearDisplay();
  display.display();
  display.setTextColor(SSD1306_WHITE);
  
}  // Void Setup

void loop() {
  // Lecture des entrées
  Etatup = digitalRead(Btnup);
  Etatdown = digitalRead(Btndown);
  Etatvalid = digitalRead(Btnvalid);

  ////////////////
  // Navigation //
  ////////////////

  if (Etatvalid == HIGH && Oldvalid == LOW) {action = !action;}
  Oldvalid = Etatvalid;

  if (action == true){
    switch (menu) {
        case 0:
          T48();
          break;
        case 1:
          G1K();
          break;
        case 2:
          TC();
          break;
        case 3:
          DMXin();
          break;
        case 4:
          DMXout();
          break;
        case 5:
          About();
          break;
    }  // switch menu
    return;
  }

  if (action == false) {
    if (Etatup == HIGH && Oldup == LOW) { menu++; }
    if (Etatdown == HIGH && Olddown == LOW) { menu--; }
    Oldup = Etatup;
    Olddown = Etatdown;

    if (menu == -1) {menu=maxi;}
    if (menu == maxi + 1)  {menu = 0;}
    minus = menu -1;
    maximus = menu +1;
    if (menu == 0) {minus = maxi; maximus = menu + 1;}
    if (menu == maxi) {minus = menu - 1; maximus = 0;} 

    display.clearDisplay();
    display.setCursor(0, 0);
    display.println();
    display.println("--- " + String(fonctions[minus]));
    display.println(">>> " + String(fonctions[menu]));
    display.println("--- " + String(fonctions[maximus]));
    display.display();
  }

}  // Void Loop

void T48() {  // Testeur 48V

  // Établissement routage  
  digitalWrite(malein, LOW);
  digitalWrite(femelleout, LOW);
  digitalWrite(maleanalo, HIGH);

  // Lecture analo
  float inchaud = analogRead(A0);
  float infroid = analogRead(A2);
  float Uchaud = inchaud * 0.056;
  float Ufroid = infroid * 0.056;

  // Affichage données
  display.clearDisplay();
  display.setCursor(0, 0);
  if (Uchaud < 30 || Ufroid < 30) { display.println("Test 48V : Mauvais"); }
  if (Uchaud >= 30 && Uchaud < 35 && Ufroid >= 30 && Ufroid < 35) { display.println("Test 48V : Faible"); }
  if (Uchaud >= 35 && Uchaud < 40 && Ufroid >= 35 && Ufroid < 40) { display.println("Test 48V : Moyen"); }
  if (Uchaud >= 40 && Ufroid >= 40) { display.println("Test 48V : Bon"); }
  display.println("Point chaud : " + String(Uchaud, 0) + "V");
  display.println("Point froid : " + String(Ufroid, 0) + "V");
  display.display();
}  // Void T48

void TC() {  // Testeur de câbles

  // Établissement routage  
  digitalWrite(malein, HIGH);
  digitalWrite(femelleout, HIGH);
  digitalWrite(maleanalo, LOW);

  if (send >= 3) { send = 0; }
  send++;

  digitalWrite(F1, LOW);
  digitalWrite(F2, LOW);
  digitalWrite(F3, LOW);

  switch (send) {
    case 1:
      digitalWrite(F1, HIGH);
      break;
    case 2:
      digitalWrite(F2, HIGH);
      break;
    case 3:
      digitalWrite(F3, HIGH);
      break;
  }

  if (send == 1) { lecture(L1); }
  if (send == 2) { lecture(L2); }
  if (send == 3) { lecture(L3); }
  
  display.clearDisplay();
  display.setCursor(0, 0);
  display.println("Testeur Cable");
  display.println("1 : " + String(L1).substring(0, 3));
  display.println("2 : " + String(L2).substring(0, 3));
  display.println("3 : " + String(L3).substring(0, 3));
  display.display();
}  // Void TC

void G1K() {  // Générateur de fréquence
  display.clearDisplay();
  centrer("Generateur 1KHz",1);
  centrer("Work in progress",3);
  display.display();
}  // Void G1K

void DMXin(){  // Entrée DMX
  display.clearDisplay();
  centrer("Entree DMX",1);
  centrer("Work in progress",3);
  display.display();
} // Void DMXin

void DMXout(){  // Entrée DMX
  display.clearDisplay();
  centrer("Sortie DMX",1);
  centrer("Work in progress",3);
  display.display();
} // Void DMXout

void About(){  // Infos
  display.clearDisplay();
  centrer("Katana",1);
  centrer("By Guesn",2);
  centrer("Version Beta",3);
  centrer("test",4);
  display.display();
}

void lecture(char transfert[5]) {

  // Lecture des entrées pour Testeur de câble
  if (digitalRead(M1)) {transfert[0] = 'X';}
  else {transfert[0] = '-';}
  if (digitalRead(M2)) {transfert[1] = 'X';}
  else {transfert[1] = '-';}
  if (digitalRead(M3)) {transfert[2] = 'X';}
  else {transfert[2] = '-';}
  
  return transfert;
}

void centrer(String message, int ligne){
  display.setCursor((128-(message.length()*6))/2, 8*(ligne-1));
  display.println(String(message));
}